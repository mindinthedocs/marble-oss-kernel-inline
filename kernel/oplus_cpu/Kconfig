## kernel/oplus_cpu/Kconfig
```kconfig
source "kernel/oplus_cpu/uad/Kconfig"

source "kernel/oplus_cpu/cpufreq_health/Kconfig"

source "kernel/oplus_cpu/sched/Kconfig"

source "kernel/oplus_cpu/cpufreq_bouncing/Kconfig"

source "kernel/oplus_cpu/oplus_omrg/Kconfig"
```
